## sdkconfig.defaults.esp32c3
```kconfig
CONFIG_PARTITION_TABLE_CUSTOM_FILENAME="partitions/v2/4m.csv"
CONFIG_SR_WN_WN9S_NIHAOXIAOZHI=y

# Фикс для 4MB Flash и SuperMini
CONFIG_ESPTOOLPY_FLASHSIZE_4MB=y
CONFIG_ESPTOOLPY_FLASHSIZE="4MB"

# Отключение ограничений по ревизии чипа (для v0.4)
CONFIG_ESP32C3_REV_MIN_FULL=0
CONFIG_ESP32C3_REV_MIN=0

# Режим работы флеш-памяти SuperMini
CONFIG_ESPTOOLPY_FLASHMODE_DIO=y
CONFIG_ESPTOOLPY_FLASHFREQ_80M=y

# Оптимизация оперативной памяти (RAM)
CONFIG_ESP_WIFI_STATIC_RX_BUFFER_NUM=3
CONFIG_ESP_WIFI_DYNAMIC_RX_BUFFER_NUM=6
CONFIG_ESP_WIFI_RX_BA_WIN=3
CONFIG_LWIP_TCPIP_RECVMBOX_SIZE=16
CONFIG_MBEDTLS_DYNAMIC_FREE_CONFIG_DATA=y

CONFIG_ESP_WIFI_ENABLE_WPA3_SAE=n
CONFIG_ESP_WIFI_ESPNOW_MAX_ENCRYPT_NUM=0
CONFIG_FREERTOS_IDLE_TASK_STACKSIZE=768
CONFIG_LWIP_IPV6=n
```
